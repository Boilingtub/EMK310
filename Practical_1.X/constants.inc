Delay1 EQU 0x1
Delay2 EQU 0x2
flash_counter EQU 0x3
tmp EQU   0x4
PORTB_val EQU 0x5
Sensor equ 0x8
rcalib equ 0x9
rcolor equ 0xB
 
Rs1 equ 0x21
Gs1 equ 0x22
Bs1 equ 0x23
Rs2 equ 0x24
Gs2 equ 0x25
Bs2 equ 0x26
Rs3 equ 0x27
Gs3 equ 0x28
Bs3 equ 0x29
Rs4 equ 0x2A
Gs4 equ 0x2B
Bs4 equ 0x2C
Rs5 equ 0x2D
Gs5 equ 0x2E
Bs5 equ 0x2F
 
SV1 equ 0x30
SV2 equ 0x31
SV3 equ 0x32
SV4 equ 0x33
SV5 equ 0x34
SVAvg equ 0x35 

mK  equ 0x36
mR  equ 0x37
mB  equ 0x38
mG  equ 0x39  
mW  equ 0x3A

K_thres  equ 0x3B
R_thres  equ 0x3C
B_thres  equ 0x3D
G_thres  equ 0x3E  
W_thres  equ 0x3F
  
nav_col equ 0x40
r_col_det equ 0x41
r_RB4_do equ 0x42
 
RGB_R	EQU 0b00000001
RGB_G   EQU 0b00000010
RGB_B	EQU 0b00000100
RGB_W	EQU 0b00000111
H333ms EQU 0x60;0xD5
L333ms EQU 0xAA;0x55
ADCAQTH EQU 0xFD
ADCAQTL EQU 0xDD
Cycles_delay	EQU 1
	
DUMP_REG EQU PORTD
RGB_REG EQU PORTC
